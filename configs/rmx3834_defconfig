## configs/rmx3834_defconfig
```kconfig
CONFIG_UMS9230=y
CONFIG_SIMPLE_FB=y
CONFIG_REALME_RMX3834=y
CONFIG_LINUX_KRNL_HEADER_IMG=y
CONFIG_POSITION_INDEPENDENT=n
CONFIG_TEXT_BASE=0x80080000
CONFIG_PAYLOAD_ENTRY=0x90000000
CONFIG_RAMDISK_ENTRY=0x85400000
```
